## conf/machine/draak.conf
```bitbake
#@TYPE: Machine
#@NAME: Draak machine
#@DESCRIPTION: Machine configuration for running Draak

SOC_FAMILY = "r8a77995"
require conf/machine/include/rcar_gen3_common.inc

DEFAULTTUNE ?= "cortexa53"
require conf/machine/include/arm/armv8a/tune-cortexa53.inc


# Device tree for D3
KERNEL_DEVICETREE = "renesas/r8a77995-draak.dtb"

# D3 u-boot configure
UBOOT_MACHINE = "r8a77995_draak_defconfig"
```

## conf/machine/include/rcar_common.inc
```bitbake
require conf/machine/include/soc-family.inc

MACHINE_FEATURES = ""

KERNEL_IMAGETYPE = "Image"
IMAGE_FSTYPES += " tar.bz2 ext4 wic.xz wic.bmap wic.xz.sha256sum"

WKS_FILE ?= "rcar-singlepart-noloader.wks"

SERIAL_CONSOLES = "115200;ttySC0"

# Configuration for kernel
PREFERRED_PROVIDER_virtual/kernel = "linux-renesas"

# Add default config to build eMMC boot mode (it should enable USE_EMMC_BOOTMODE = "1" local.conf)
USE_EMMC_BOOTMODE ?= "0"

# Configuration for ARM Trusted Firmware
EXTRA_IMAGEDEPENDS += " arm-trusted-firmware optee-os"

# u-boot
PREFERRED_VERSION_u-boot = "v2020.10%"
EXTRA_IMAGEDEPENDS += " u-boot"

# Add variable to Build Configuration in build log
BUILDCFG_VARS:append = " SOC_FAMILY"

# rsync is required to build kernel 5.4
HOSTTOOLS += "rsync"
```

## conf/machine/include/rcar_gen3_common.inc
```bitbake
SOC_FAMILY =. "rcar-gen3:"

require conf/machine/include/rcar_common.inc

IMAGE_FSTYPES += " ext4 wic.xz wic.bmap wic.xz.sha256sum"

WKS_FILE ?= "rcar-singlepart-noloader.wks"
```

## conf/machine/include/rcar_gen4_common.inc
```bitbake
SOC_FAMILY =. "rcar-gen4:"

require conf/machine/include/rcar_common.inc

IMAGE_FSTYPES += " ext4"
```

## conf/machine/m3nulcb.conf
```bitbake
#@TYPE: Machine
#@NAME: M3NULCB machine
#@DESCRIPTION: Machine configuration for running M3NULCB

SOC_FAMILY = "r8a77965"
require conf/machine/include/rcar_gen3_ulcb.inc

DEFAULTTUNE ?= "cortexa57"
require conf/machine/include/arm/armv8a/tune-cortexa57.inc

# Device tree for M3NULCB
KERNEL_DEVICETREE = "renesas/r8a77965-ulcb.dtb"

# M3NULCB u-boot configure
UBOOT_MACHINE = "rcar3_ulcb_defconfig"
```

## conf/machine/s4sk.conf
```bitbake
#@TYPE: Machine
#@NAME: S4SK machine
#@DESCRIPTION: Machine configuration for running S4 Starter kit

SOC_FAMILY = "r8a779f"
DEFAULTTUNE ?= "cortexa55"

require conf/machine/include/arm/armv8-2a/tune-cortexa55.inc
require conf/machine/include/rcar_gen4_common.inc

# Device tree for S4
KERNEL_DEVICETREE = "\
    renesas/r8a779f4-s4sk.dtb \
"

# S4 u-boot configure
UBOOT_MACHINE = "r8a779f0_s4sk_defconfig"
```

## conf/machine/spider.conf
```bitbake
#@TYPE: Machine
#@NAME: Spider machine
#@DESCRIPTION: Machine configuration for running Spider

SOC_FAMILY = "r8a779f0"
require conf/machine/include/rcar_gen4_common.inc

DEFAULTTUNE ?= "cortexa55"
require conf/machine/include/arm/armv8-2a/tune-cortexa55.inc

# Device tree for Spider
KERNEL_DEVICETREE = " \
    renesas/r8a779f0-spider.dtb \
"

# Spider u-boot configure
UBOOT_MACHINE = "r8a779f0_spider_defconfig"
```
